## main/Kconfig.projbuild
```kconfig
menu "Connection Configuration"

    config ESP_WIFI_SSID
        string "WiFi SSID"
        default "myssid"
        help
            SSID (network name) for the example to connect to.

    config ESP_WIFI_PASSWORD
        string "WiFi Password"
        default "mypassword"
        help
            WiFi password (WPA or WPA2) for the example to use.

    config ESP_MAXIMUM_RETRY
        int "Maximum retry"
        default 5
        help
            Set the Maximum retry to avoid station reconnecting to the AP unlimited when the AP is really inexistent.

    config ESP_MQTT_SERVER
        string "Mqtt Server Address"
        default "127.0.0.1"
        help
            Set the ip address of the mqtt broker to connect to.

    config ESP_MQTT_USER
        string "Mqtt User"
        default "mqtt"
        help
            Set username to use with mqtt broker.

    config ESP_MQTT_PASSWORD
        string "Mqtt Server Password"
        default "mqttpassword"
        help
            Set password to use with mqtt broker.

endmenu
```
